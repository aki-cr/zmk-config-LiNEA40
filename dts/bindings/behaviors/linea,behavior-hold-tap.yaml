## dts/bindings/behaviors/linea,behavior-hold-tap.yaml
```yaml
# Copyright (c) 2020 The ZMK Contributors
# SPDX-License-Identifier: MIT

description: |
  LiNEA40 用の Hold or Tap（ZMK の zmk,behavior-hold-tap と同じ。長押しの判定の値を LiNEA40 Studio からすぐ変えられる）

compatible: "linea,behavior-hold-tap"

include: two_param.yaml

properties:
  bindings:
    type: phandles
    required: true
  tapping-term-ms:
    type: int
  tapping_term_ms:
    type: int
    deprecated: true
  quick-tap-ms:
    type: int
    default: -1
  quick_tap_ms:
    type: int
    deprecated: true
  global-quick-tap:
    type: boolean
    deprecated: true
  require-prior-idle-ms:
    type: int
    default: -1
  flavor:
    type: string
    required: false
    default: "hold-preferred"
    enum:
      - "hold-preferred"
      - "balanced"
      - "tap-preferred"
      - "tap-unless-interrupted"
  hold-while-undecided:
    type: boolean
  hold-while-undecided-linger:
    type: boolean
  retro-tap:
    type: boolean
  hold-trigger-key-positions:
    type: array
    required: false
    default: []
  hold-trigger-on-release:
    type: boolean
```

## dts/bindings/input_processors/linea,input-processor-accel.yaml
```yaml
description: |
  LiNEA40 用のトラボの加速。動かす速さ（1回の報告あたりの移動量）に応じて、
  X/Y の移動量に min〜max の倍率をかける（端数は持ち越す）。

compatible: "linea,input-processor-accel"

include: ip_zero_param.yaml

properties:
  min-factor-milli:
    type: int
    default: 1000
    description: ゆっくり動かしたときの倍率（1000 = 1倍）
  max-factor-milli:
    type: int
    default: 1000
    description: 速く動かしたときの倍率（1000 = 1倍）
  speed-low:
    type: int
    default: 2
    description: この移動量以下は min-factor-milli
  speed-high:
    type: int
    default: 20
    description: この移動量以上は max-factor-milli（間はなめらかにつなぐ）
  min-interval-ms:
    type: int
    default: 0
    description: |
      0 より大きいと、移動量をためてこの間隔より短くは送らない（間の報告は 0 にする）。
      スクロールを Conductor と同じ約15ms おきの信号にして、Mac Mouse Fix の加速が効くようにするため
  settings-slot:
    type: int
    default: 0
    description: |
      1 にすると、LiNEA40 Studio から Bluetooth で変えた「カーソルの速さ」の倍率を掛ける（linea_settings）。
      ビルドせずに速さを変えるため。0 なら掛けない
  precision-layer:
    type: int
    default: -1
    description: このレイヤーがいちばん上のとき、移動量を 1/precision-divisor にする（精密モード）。-1 なら使わない
  precision-divisor:
    type: int
    default: 1
    description: 精密モードの割合（LiNEA40 Studio から変えた値があればそちら）
  enable-default:
    type: int
    default: 1
    description: 0 なら、LiNEA40 Studio でオンにするまで倍率を掛けない（settings-slot 3 のスクロールの加速）
```

## dts/bindings/input_processors/linea,input-processor-aml.yaml
```yaml
description: |
  LiNEA40 用のオートマウス。ZMK の zmk,input-processor-temp-layer（zip_temp_layer）と同じ動きで、
  抜けるまでの時間・直前のキー入力の待ち・抜けないキーを LiNEA40 Studio からすぐ変えられる（linea_settings）。
  ここに書いた値は、LiNEA40 Studio で変えていないときの値。

compatible: "linea,input-processor-aml"

include: ip_zero_param.yaml

properties:
  layer:
    type: int
    required: true
    description: ボールを動かすと入るレイヤー
  timeout-ms:
    type: int
    default: 60000
    description: これだけ動かさないと抜ける
  require-prior-idle-ms:
    type: int
    default: 0
    description: 直前のキー入力からこの時間以内の動きでは入らない
  excluded-positions:
    type: array
    default: []
    description: 押しても抜けないキー
```

## dts/bindings/input_processors/linea,input-processor-dex-scroll.yaml
```yaml
description: |
  DeX モード（linea_dex.c。プロファイル 3）のときだけ、ホイールの信号の向きを逆にし、量に倍率をかける。
  向きと倍率は LiNEA40 Studio から変えられる（設定 29・30）。

compatible: "linea,input-processor-dex-scroll"

include: ip_zero_param.yaml
```

## dts/bindings/input_processors/linea,input-processor-gesture.yaml
```yaml
description: |
  LiNEA40 用の Gesture。指定レイヤーにいる間、トラボを上下左右に一定量転がすと、
  そのレイヤーの up/down/left/right の位置に置いたキーを1回押す（カーソルは動かさない）。

compatible: "linea,input-processor-gesture"

include: ip_zero_param.yaml

properties:
  layer:
    type: int
    required: true
  up:
    type: int
    required: true
  down:
    type: int
    required: true
  left:
    type: int
    required: true
  right:
    type: int
    required: true
  threshold:
    type: int
    default: 40
    description: これだけ転がしたら1回（センサーの単位）
  idle-ms:
    type: int
    default: 250
    description: これだけ止まったら次を受け付ける
```

## dts/bindings/input_processors/linea,input-processor-tick.yaml
```yaml
description: |
  LiNEA40 用のスクロールの刻み。ホイールの信号を1回あたり ±1 段にそろえ（エンコーダーと同じ形）、
  あふれた分は max-carry 段まで持ち越して次の報告で送る。

compatible: "linea,input-processor-tick"

include: ip_zero_param.yaml

properties:
  max-carry:
    type: int
    default: 3
    description: 持ち越す段数の上限
  enable-default:
    type: int
    default: 1
    description: 0 なら、LiNEA40 Studio でオンにするまで何もしない（まとめて送る）
  pace-default:
    type: int
    default: 0
    description: |
      1 にすると、届いた段を貯めて平均の間隔で1段ずつ送り出す（転がし直しのすき間でスクロールが止まらないように）。
      LiNEA40 Studio から切り替えられる。送り出した信号は、この部品を device にした input-listener が Mac に送る
  pace-buffer:
    type: int
    default: 12
    description: すき間を埋めるときに貯める段の上限（指を離したあと流れ続けすぎないように）
```

## dts/bindings/linea,combos.yaml
```yaml
# Copyright (c) 2020, The ZMK Contributors
# SPDX-License-Identifier: MIT

description: |
  LiNEA40 用のコンボの入れ物（ZMK の zmk,combos と同じ書き方）。
  ここに書いたコンボは、LiNEA40 Studio で変えていないときの値（src/linea_combo.c が読む）

compatible: "linea,combos"

child-binding:
  description: "A combo"

  properties:
    bindings:
      type: phandle-array
      required: true
    key-positions:
      type: array
      required: true
    timeout-ms:
      type: int
      default: 50
    require-prior-idle-ms:
      type: int
      default: -1
    slow-release:
      type: boolean
    layers:
      type: array
      default: [-1]
```
